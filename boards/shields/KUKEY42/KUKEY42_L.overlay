#include "KUKEY42.dtsi"

&kscan0 {
        col-gpios
            = <&xiao_d 10 GPIO_ACTIVE_HIGH>
            , <&xiao_d 9 GPIO_ACTIVE_HIGH> 
            , <&xiao_d 8 GPIO_ACTIVE_HIGH> 
            , <&xiao_d 7 GPIO_ACTIVE_HIGH> 
            , <&gpio0 10 GPIO_ACTIVE_HIGH>
            , <&gpio0 9 GPIO_ACTIVE_HIGH>
            ;
};

&left_encoder {
    status = "okay";
};

// Q を押したまま USB ケーブルを挿すと、ブートローダになる (src/usb_bootmagic.c)
/ {
    usb_bootmagic {
        compatible = "zmk,usb-bootmagic";
        row = <0>;
        column = <0>;
    };
};
